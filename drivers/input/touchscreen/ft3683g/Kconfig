## drivers/input/touchscreen/ft3683g/Kconfig
```kconfig
config TOUCHSCREEN_FOCALTECH_FT3683G
	tristate "focaltech tianma spi touchscreen"
	depends on SPI
	select TOUCHSCREEN_XIAOMI_TOUCHFEATURE_COMMON
	default m
	help
	  Say Y here if you have a focaltech series touch controller
	  to your system.
	  If build module, say M.
	  If unsure, say N.
```

## drivers/tee/mitee/Kconfig
```kconfig
# MI-TEE Trusted Execution Environment Configuration
config MITEE_SUPPORT
	tristate "Enable MITEE Support"
	help
	  This implements the MI-TEE Trusted Execution Environment (TEE)
	  feature.

config MITEE_SHM_NUM_PRIV_PAGES
	int "Number of private pages for a MI-TEE shared memory pool"
	depends on MITEE_SUPPORT
	default 3
	help
	  Number of pages reserved at the start of the MI-TEE shared memory
	  region that are kept private to the driver.
```
